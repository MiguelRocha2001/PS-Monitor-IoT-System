## MCU/IoT_System_MCU/main/Kconfig.projbuild
```kconfig
menu "Application Configuration"

    config GPIO_RESET_PIN
        int "GPIO reset pin"
        default 16
        help
            Select pin that resets the saved parameters when set to HIGH.

endmenu
```
